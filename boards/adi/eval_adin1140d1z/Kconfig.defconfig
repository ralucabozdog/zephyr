## boards/adi/eval_adin1140d1z/Kconfig.defconfig
```kconfig
# Copyright (c) 2024-2026 Analog Devices, Inc.
# SPDX-License-Identifier: Apache-2.0

if BOARD_ADI_EVAL_ADIN1140D1Z

config SPI_MAX32_DMA
	default y

configdefault MDIO_INIT_PRIORITY
	default 81

configdefault PHY_INIT_PRIORITY
	default 82

configdefault NET_IF_MAX_IPV4_COUNT
	default 2

configdefault NET_L2_ETHERNET
	default y

endif # BOARD_ADI_EVAL_ADIN1140D1Z
```

## boards/shields/ad_apardpfw_sl/Kconfig.shield
```kconfig
# Copyright (c) 2026 Analog Devices, Inc.
# SPDX-License-Identifier: Apache-2.0

config SHIELD_AD_APARDPFW_SL
	def_bool $(shields_list_contains,ad_apardpfw_sl)
```
