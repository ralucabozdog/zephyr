/*
 * SPDX-FileCopyrightText: Copyright The Zephyr Project Contributors
 * SPDX-License-Identifier: Apache-2.0
 */

#include <zephyr/dt-bindings/adc/adc.h>
#include <zephyr/dt-bindings/gpio/gpio.h>
#include <zephyr/dt-bindings/gpio/mikro-bus.h>

&mikrobus_spi {
	status = "okay";

	ad7091r_mikroe_iso_adc_2_click: ad7091r@0 {
		compatible = "adi,ad7091r";
		reg = <0x0>;
		/* The SPI signals cross the ADuM5401 digital isolator */
		spi-max-frequency = <100000>;
		/* CONVST is routed to the mikroBUS RST pin */
		convst-gpios = <&mikrobus_header MIKROBUS_RST GPIO_ACTIVE_LOW>;
		#address-cells = <1>;
		#size-cells = <0>;
		#io-channel-cells = <1>;

		channel@0 {
			reg = <0>;
			zephyr,gain = "ADC_GAIN_1";
			zephyr,reference = "ADC_REF_INTERNAL";
			zephyr,vref-mv = <2500>;
			zephyr,acquisition-time = <ADC_ACQ_TIME_DEFAULT>;
			zephyr,resolution = <12>;
		};
	};
};
