## boards/shields/mikroe_ad_swio_3_click/Kconfig.shield
```kconfig
# SPDX-FileCopyrightText: Copyright The Zephyr Project Contributors
# SPDX-License-Identifier: Apache-2.0

config SHIELD_MIKROE_AD_SWIO_3_CLICK
	def_bool $(shields_list_contains,mikroe_ad_swio_3_click)
```

## boards/shields/mikroe_iso_adc_2_click/Kconfig.shield
```kconfig
# SPDX-FileCopyrightText: Copyright The Zephyr Project Contributors
# SPDX-License-Identifier: Apache-2.0

config SHIELD_MIKROE_ISO_ADC_2_CLICK
	def_bool $(shields_list_contains,mikroe_iso_adc_2_click)
```

## drivers/adc/Kconfig.ad7091r
```kconfig
# SPDX-FileCopyrightText: Copyright The Zephyr Project Contributors
# SPDX-License-Identifier: Apache-2.0

config ADC_AD7091R
	bool "AD7091R ADC driver"
	default y
	depends on DT_HAS_ADI_AD7091R_ENABLED
	select SPI
	select GPIO
	help
	  Enable the ADC driver for the Analog Devices AD7091R 12-bit,
	  1 MSPS successive approximation ADC.
```

## drivers/adc/Kconfig.ad74115h
```kconfig
# SPDX-FileCopyrightText: Copyright The Zephyr Project Contributors
# SPDX-License-Identifier: Apache-2.0

config ADC_AD74115H
	bool "AD74115H ADC driver"
	default y
	depends on DT_HAS_ADI_AD74115H_ENABLED
	select SPI
	select CRC
	help
	  Enable the ADC driver for the Analog Devices AD74115H software
	  configurable input/output. The channel is configured for voltage
	  input and measured with the primary ADC conversion.
```

## drivers/hwinfo/Kconfig.alif
```kconfig
# SPDX-FileCopyrightText: Copyright (c) 2026 Analog Devices, Inc.
# SPDX-License-Identifier: Apache-2.0

config HWINFO_ALIF
	bool "Alif hwinfo driver"
	default y
	depends on SOC_FAMILY_BALLETTO || SOC_FAMILY_ENSEMBLE_RTSS
	select HWINFO_HAS_DRIVER
	help
	  Enable the Alif hwinfo driver, which reports the SoC serial number
	  read from the Secure Enclave as device ID.
```

## drivers/usb/udc/Kconfig.dwc3
```kconfig
# Copyright (c) 2025 Alif Semiconductor
# Copyright (c) 2026 Analog Devices, Inc.
# SPDX-License-Identifier: Apache-2.0

config UDC_DWC3
	bool "DWC3 USB device controller driver"
	default y
	depends on DT_HAS_SNPS_DWC3_ENABLED
	select UDC_DRIVER_HAS_HIGH_SPEED_SUPPORT
	help
	  Driver for the DesignWare USB 3.0 (DWC_usb3) controller operating as a
	  USB 2.0 device. Control, bulk and interrupt transfers are supported.

if UDC_DWC3

config UDC_DWC3_STACK_SIZE
	int "UDC DWC3 driver internal thread stack size"
	default 1024
	help
	  DWC3 driver internal thread stack size.

config UDC_DWC3_THREAD_PRIORITY
	int "UDC DWC3 driver thread priority"
	default 8
	help
	  DWC3 driver thread priority.

endif # UDC_DWC3
```

## dts/bindings/adc/adi,ad7091r.yaml
```yaml
# SPDX-FileCopyrightText: Copyright The Zephyr Project Contributors
# SPDX-License-Identifier: Apache-2.0

description: |
  Analog Devices AD7091R 12-bit, 1 MSPS successive approximation ADC

  ADC channel 0 measures 0 V to VREF with 12-bit resolution. With the
  internal 2.5 V reference, its channel node uses
  zephyr,reference = "ADC_REF_INTERNAL", zephyr,vref-mv = <2500> and
  zephyr,resolution = <12>. With an external reference on REFIN/REFOUT,
  use zephyr,reference = "ADC_REF_EXTERNAL0" and set zephyr,vref-mv to the
  reference voltage.

  The device shifts data out on the falling SCLK edge and SCLK must idle
  low, so leave the spi-cpol and spi-cpha properties unset (SPI mode 0).

compatible: "adi,ad7091r"

include: [adc-controller.yaml, spi-device.yaml]

on-bus: spi

properties:
  "#io-channel-cells":
    const: 1

  convst-gpios:
    type: phandle-array
    required: true
    description: |
      GPIO connected to the CONVST pin. A conversion starts on the falling
      edge of CONVST, so flag the GPIO as GPIO_ACTIVE_LOW.

io-channel-cells:
  - input
```

## dts/bindings/adc/adi,ad74115h.yaml
```yaml
# SPDX-FileCopyrightText: Copyright The Zephyr Project Contributors
# SPDX-License-Identifier: Apache-2.0

description: |
  Analog Devices AD74115H single-channel software configurable input/output

  The channel is configured for voltage input. ADC channel 0 is the primary
  ADC conversion and measures 0 V to 12 V with 16-bit resolution, so its
  channel node uses zephyr,reference = "ADC_REF_INTERNAL",
  zephyr,vref-mv = <12000> and zephyr,resolution = <16>.

  The device samples on the falling SCLK edge; select the matching SPI
  mode with the spi-cpol and spi-cpha properties.

compatible: "adi,ad74115h"

include: [adc-controller.yaml, spi-device.yaml]

on-bus: spi

properties:
  "#io-channel-cells":
    const: 1

  reset-gpios:
    type: phandle-array
    description: |
      GPIO connected to the active-low RESET pin. A software reset is used
      when this property is not present.

io-channel-cells:
  - input
```

## dts/bindings/usb/snps,dwc3.yaml
```yaml
# Copyright (c) 2025 Alif Semiconductor
# Copyright (c) 2026 Analog Devices, Inc.
# SPDX-License-Identifier: Apache-2.0

description: |
  DesignWare USB 3.0 (DWC_usb3) controller in USB 2.0 device mode

  The controller reads and writes memory as a bus master. When it reaches
  memory at other addresses than the CPU, for example tightly coupled memory
  through a system alias, describe the translation with dma-ranges in the
  parent bus node. When it can reach only part of the memory, reference that
  part with memory-regions, where the driver places its event buffer and
  transfer descriptors.

compatible: "snps,dwc3"

include: [usb-controller.yaml, memory-region.yaml]

properties:
  reg:
    required: true

  interrupts:
    required: true

  clocks:
    required: true
    description: |
      Clocks to enable before accessing the controller. All of them must be
      provided by the same clock controller.

  num-in-eps:
    type: int
    required: true
    description: |
      Number of IN endpoints including the control endpoint.

  num-out-eps:
    type: int
    required: true
    description: |
      Number of OUT endpoints including the control endpoint.

  utmi-width:
    type: int
    default: 8
    enum: [8, 16]
    description: |
      Data width in bits of the UTMI+ interface to the USB 2.0 PHY. The
      default is the reset value of the controller.
```
